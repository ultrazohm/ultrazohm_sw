ASAP2_VERSION 1 71
/begin PROJECT UltraZohm "UltraZohm XCPlite demo (auto-generated by gen_a2l.py)"
/begin HEADER "UltraZohm A53 XCPlite slave" VERSION "1.0" /end HEADER
/begin MODULE CPP "XCPlite on A53 / FreeRTOS / lwIP (UDP)"
/begin MOD_COMMON "" BYTE_ORDER MSB_LAST ALIGNMENT_BYTE 1 ALIGNMENT_WORD 2 ALIGNMENT_LONG 4 ALIGNMENT_FLOAT32_IEEE 4 /end MOD_COMMON
/begin RECORD_LAYOUT RL_U32 FNC_VALUES 1 ULONG ROW_DIR DIRECT /end RECORD_LAYOUT
/begin RECORD_LAYOUT RL_F32 FNC_VALUES 1 FLOAT32_IEEE ROW_DIR DIRECT /end RECORD_LAYOUT
/begin COMPU_METHOD identity "1:1 identity" RAT_FUNC "%.6" "" COEFFS 0 1 0 0 0 1 /end COMPU_METHOD
/begin MEASUREMENT xcp_demo_counter "Phase 1: 1 kHz free-running up-counter" ULONG identity 0 0 0 4294967295 ECU_ADDRESS 0x002002B4
 /begin IF_DATA XCP
  /begin DAQ_EVENT FIXED_EVENT_LIST EVENT 0x0000 /end DAQ_EVENT
 /end IF_DATA
/end MEASUREMENT
/begin MEASUREMENT xcp_demo_sine "Phase 1: 1 Hz sine, range [-1, +1]" FLOAT32_IEEE identity 0 0 -3.4E38 3.4E38 ECU_ADDRESS 0x002002B8
 /begin IF_DATA XCP
  /begin DAQ_EVENT FIXED_EVENT_LIST EVENT 0x0000 /end DAQ_EVENT
 /end IF_DATA
/end MEASUREMENT
/begin MEASUREMENT xcp_meas_local_timestamp_us "Phase 3: R5 image timestamp [us]" ULONG identity 0 0 0 4294967295 ECU_ADDRESS 0x00200288
 /begin IF_DATA XCP
  /begin DAQ_EVENT FIXED_EVENT_LIST EVENT 0x0000 /end DAQ_EVENT
 /end IF_DATA
/end MEASUREMENT
/begin MEASUREMENT xcp_meas_local_signal_0 "Phase 3: R5 image signal channel 0" FLOAT32_IEEE identity 0 0 -3.4E38 3.4E38 ECU_ADDRESS 0x00200290
 /begin IF_DATA XCP
  /begin DAQ_EVENT FIXED_EVENT_LIST EVENT 0x0000 /end DAQ_EVENT
 /end IF_DATA
/end MEASUREMENT
/begin MEASUREMENT xcp_meas_local_signal_1 "Phase 3: R5 image signal channel 1" FLOAT32_IEEE identity 0 0 -3.4E38 3.4E38 ECU_ADDRESS 0x00200294
 /begin IF_DATA XCP
  /begin DAQ_EVENT FIXED_EVENT_LIST EVENT 0x0000 /end DAQ_EVENT
 /end IF_DATA
/end MEASUREMENT
/begin MEASUREMENT xcp_meas_local_signal_2 "Phase 3: R5 image signal channel 2" FLOAT32_IEEE identity 0 0 -3.4E38 3.4E38 ECU_ADDRESS 0x00200298
 /begin IF_DATA XCP
  /begin DAQ_EVENT FIXED_EVENT_LIST EVENT 0x0000 /end DAQ_EVENT
 /end IF_DATA
/end MEASUREMENT
/begin MEASUREMENT xcp_meas_local_signal_3 "Phase 3: R5 image signal channel 3" FLOAT32_IEEE identity 0 0 -3.4E38 3.4E38 ECU_ADDRESS 0x0020029C
 /begin IF_DATA XCP
  /begin DAQ_EVENT FIXED_EVENT_LIST EVENT 0x0000 /end DAQ_EVENT
 /end IF_DATA
/end MEASUREMENT
/begin MEASUREMENT xcp_meas_local_signal_4 "Phase 3: R5 image signal channel 4" FLOAT32_IEEE identity 0 0 -3.4E38 3.4E38 ECU_ADDRESS 0x002002A0
 /begin IF_DATA XCP
  /begin DAQ_EVENT FIXED_EVENT_LIST EVENT 0x0000 /end DAQ_EVENT
 /end IF_DATA
/end MEASUREMENT
/begin MEASUREMENT xcp_meas_local_signal_5 "Phase 3: R5 image signal channel 5" FLOAT32_IEEE identity 0 0 -3.4E38 3.4E38 ECU_ADDRESS 0x002002A4
 /begin IF_DATA XCP
  /begin DAQ_EVENT FIXED_EVENT_LIST EVENT 0x0000 /end DAQ_EVENT
 /end IF_DATA
/end MEASUREMENT
/begin MEASUREMENT xcp_meas_local_signal_6 "Phase 3: R5 image signal channel 6" FLOAT32_IEEE identity 0 0 -3.4E38 3.4E38 ECU_ADDRESS 0x002002A8
 /begin IF_DATA XCP
  /begin DAQ_EVENT FIXED_EVENT_LIST EVENT 0x0000 /end DAQ_EVENT
 /end IF_DATA
/end MEASUREMENT
/begin MEASUREMENT xcp_meas_local_signal_7 "Phase 3: R5 image signal channel 7" FLOAT32_IEEE identity 0 0 -3.4E38 3.4E38 ECU_ADDRESS 0x002002AC
 /begin IF_DATA XCP
  /begin DAQ_EVENT FIXED_EVENT_LIST EVENT 0x0000 /end DAQ_EVENT
 /end IF_DATA
/end MEASUREMENT
/begin IF_DATA XCP
 /begin PROTOCOL_LAYER 0x0100 1000 2000 0 0 0 0 0 0 248 248 BYTE_ORDER_MSB_LAST ADDRESS_GRANULARITY_BYTE OPTIONAL_CMD GET_DAQ_CLOCK OPTIONAL_CMD SHORT_UPLOAD /end PROTOCOL_LAYER
 /begin DAQ DYNAMIC 0 1 0 OPTIMISATION_TYPE_DEFAULT ADDRESS_EXTENSION_FREE IDENTIFICATION_FIELD_TYPE_ABSOLUTE GRANULARITY_ODT_ENTRY_SIZE_DAQ_BYTE 0xF8 NO_OVERLOAD_INDICATION /begin TIMESTAMP_SUPPORTED 0x1 SIZE_DWORD UNIT_1US TIMESTAMP_FIXED /end TIMESTAMP_SUPPORTED /begin EVENT "DAQ_1ms" "DAQ1ms" 0x0000 DAQ 0xFF 0x01 0x07 0x00 /end EVENT /end DAQ
 /begin XCP_ON_UDP_IP 0x0100 5556 ADDRESS "192.168.1.42" /end XCP_ON_UDP_IP
/end IF_DATA
/end MODULE
/end PROJECT
