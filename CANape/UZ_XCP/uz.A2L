/* generated by ASAP2 Studio 20.0.10.42 */ ASAP2_VERSION 1 71
/begin PROJECT UltraZohm_XCP ""
/begin MODULE ModuleName ""
/begin MOD_PAR "" /end MOD_PAR
/begin MOD_COMMON "" ALIGNMENT_BYTE 1 ALIGNMENT_WORD 2 ALIGNMENT_LONG 4 ALIGNMENT_FLOAT16_IEEE 2 ALIGNMENT_FLOAT32_IEEE 4 ALIGNMENT_FLOAT64_IEEE 8 ALIGNMENT_INT64 8 /end MOD_COMMON
/begin IF_DATA XCP
 /begin PROTOCOL_LAYER 0x0103 0x07D0 0x2710 0x00 0x00 0x00 0x00 0x00 0xF8 0xF8 BYTE_ORDER_MSB_LAST ADDRESS_GRANULARITY_BYTE OPTIONAL_CMD ALLOC_ODT_ENTRY OPTIONAL_CMD ALLOC_ODT OPTIONAL_CMD ALLOC_DAQ OPTIONAL_CMD FREE_DAQ OPTIONAL_CMD GET_DAQ_EVENT_INFO OPTIONAL_CMD GET_DAQ_RESOLUTION_INFO OPTIONAL_CMD GET_DAQ_PROCESSOR_INFO OPTIONAL_CMD GET_DAQ_CLOCK OPTIONAL_CMD START_STOP_SYNCH OPTIONAL_CMD START_STOP_DAQ_LIST OPTIONAL_CMD GET_DAQ_LIST_MODE OPTIONAL_CMD SET_DAQ_LIST_MODE OPTIONAL_CMD WRITE_DAQ OPTIONAL_CMD SET_DAQ_PTR OPTIONAL_CMD CLEAR_DAQ_LIST OPTIONAL_CMD DOWNLOAD OPTIONAL_CMD UPLOAD OPTIONAL_CMD SET_MTA OPTIONAL_CMD GET_COMM_MODE_INFO /end PROTOCOL_LAYER
 /begin DAQ DYNAMIC 0x00 0x05 0x00 OPTIMISATION_TYPE_DEFAULT ADDRESS_EXTENSION_FREE IDENTIFICATION_FIELD_TYPE_RELATIVE_WORD_ALIGNED GRANULARITY_ODT_ENTRY_SIZE_DAQ_BYTE 0xF8 NO_OVERLOAD_INDICATION /begin TIMESTAMP_SUPPORTED 0x01 SIZE_DWORD UNIT_1US TIMESTAMP_FIXED /end TIMESTAMP_SUPPORTED /begin EVENT "DAQ_R5" "DAQ_R5" 0x00 DAQ 0xFF 0xFA 0x02 0x00 /end EVENT /begin EVENT "daq_1ms" "daq_1ms" 0x01 DAQ 0xFF 0x64 0x04 0x00 /end EVENT /begin EVENT "daq_10ms" "daq_10ms" 0x02 DAQ 0xFF 0x64 0x05 0x00 /end EVENT /begin EVENT "daq_100ms" "daq_100ms" 0x03 DAQ 0xFF 0x64 0x06 0x00 /end EVENT /begin EVENT "daq_1s" "daq_1s" 0x04 DAQ 0xFF 0x64 0x07 0x00 /end EVENT /end DAQ
 /begin PAG 0x00 /end PAG
 /begin PGM PGM_MODE_ABSOLUTE 0x00 0x00 /end PGM
 /begin XCP_ON_UDP_IP 0x0103 0x15B4 ADDRESS "192.168.1.233" /end XCP_ON_UDP_IP
/end IF_DATA
/begin MEASUREMENT Global_Data.aa "" UBYTE NO_COMPU_METHOD 0 0 0 255 ECU_ADDRESS 0x40059C68 /end MEASUREMENT
/begin MEASUREMENT Global_Data.aa.A1.me.ADC_array "" FLOAT32_IEEE NO_COMPU_METHOD 0 0 -3.40282346639E+38 3.40282346639E+38 ECU_ADDRESS 0x40059C88 MATRIX_DIM 8 /end MEASUREMENT
/begin MEASUREMENT ISR_execution_time_us "live from timingR5 (uz_SystemTime)" FLOAT32_IEEE NO_COMPU_METHOD 0 0 -3.40282346639E+38 3.40282346639E+38 ECU_ADDRESS 0x4005B2DC SYMBOL_LINK "timingR5.isr_execution_time_us" 0 /end MEASUREMENT
/begin MEASUREMENT ISR_period_us "live from timingR5 (uz_SystemTime)" FLOAT32_IEEE NO_COMPU_METHOD 0 0 -3.40282346639E+38 3.40282346639E+38 ECU_ADDRESS 0x4005B2D8 SYMBOL_LINK "timingR5.isr_period_us" 0 /end MEASUREMENT
/begin MEASUREMENT interrupt_counter "ISR tick counter, live from timingR5 (replaces dead lifecheck)" A_UINT64 NO_COMPU_METHOD 0 0 0 1.84467440737E+19 ECU_ADDRESS 0x4005B2E0 SYMBOL_LINK "timingR5.interrupt_counter" 0 /end MEASUREMENT
/begin MEASUREMENT xcp_r5_queue_lost "DAQ samples dropped in R5 queue (must stay 0; NOT visible as wire CTR gap)" ULONG NO_COMPU_METHOD 0 0 0 4294967295 ECU_ADDRESS 0x400B9FA8 /end MEASUREMENT
/begin MEASUREMENT xcp_r5_sweep_gap_max_us "max gap between main-loop XCP sweeps [us] (queue headroom indicator)" ULONG NO_COMPU_METHOD 0 0 0 4294967295 ECU_ADDRESS 0x400BA3D8 /end MEASUREMENT
/begin MEASUREMENT xcp_r5_tx_oversize_drop "R5 TX frames dropped for oversize (must stay 0)" ULONG NO_COMPU_METHOD 0 0 0 4294967295 ECU_ADDRESS 0x400B9FAC /end MEASUREMENT
/begin COMPU_METHOD FOC_SCF_P.FOC_ENABLE_Idq_Ref.Conversion "" TAB_VERB "%6.3" "" COMPU_TAB_REF FOC_SCF_P.FOC_ENABLE_Idq_Ref.Conversion.StatusTable /end COMPU_METHOD
/begin COMPU_VTAB FOC_SCF_P.FOC_ENABLE_Idq_Ref.Conversion.StatusTable "" TAB_VERB 2 0 "OFF" 1 "ON" /end COMPU_VTAB
/begin RECORD_LAYOUT __Float32_Value FNC_VALUES 1 FLOAT32_IEEE ROW_DIR DIRECT /end RECORD_LAYOUT
/end MODULE
/end PROJECT
