/* generated by ASAP2 Studio 21.0.1.188 */ ASAP2_VERSION 1 71
/begin PROJECT UltraZohm_XCP ""
/begin MODULE ModuleName ""
/begin MOD_PAR "" /end MOD_PAR
/begin MOD_COMMON "" ALIGNMENT_BYTE 1 ALIGNMENT_WORD 2 ALIGNMENT_LONG 4 ALIGNMENT_FLOAT16_IEEE 2 ALIGNMENT_FLOAT32_IEEE 4 ALIGNMENT_FLOAT64_IEEE 8 ALIGNMENT_INT64 8 /end MOD_COMMON
/begin IF_DATA XCP
 /begin PROTOCOL_LAYER 0x0103 0x1388 0x2710 0x00 0x00 0x00 0x00 0x00 0xF8 0x0400 BYTE_ORDER_MSB_LAST ADDRESS_GRANULARITY_BYTE OPTIONAL_CMD ALLOC_ODT_ENTRY OPTIONAL_CMD ALLOC_ODT OPTIONAL_CMD ALLOC_DAQ OPTIONAL_CMD FREE_DAQ OPTIONAL_CMD GET_DAQ_EVENT_INFO OPTIONAL_CMD GET_DAQ_RESOLUTION_INFO OPTIONAL_CMD GET_DAQ_PROCESSOR_INFO OPTIONAL_CMD GET_DAQ_CLOCK OPTIONAL_CMD START_STOP_SYNCH OPTIONAL_CMD START_STOP_DAQ_LIST OPTIONAL_CMD GET_DAQ_LIST_MODE OPTIONAL_CMD SET_DAQ_LIST_MODE OPTIONAL_CMD WRITE_DAQ OPTIONAL_CMD SET_DAQ_PTR OPTIONAL_CMD CLEAR_DAQ_LIST OPTIONAL_CMD DOWNLOAD OPTIONAL_CMD UPLOAD OPTIONAL_CMD SET_MTA OPTIONAL_CMD GET_COMM_MODE_INFO /end PROTOCOL_LAYER
 /begin DAQ DYNAMIC 0x00 0x05 0x00 OPTIMISATION_TYPE_DEFAULT ADDRESS_EXTENSION_FREE IDENTIFICATION_FIELD_TYPE_RELATIVE_WORD_ALIGNED GRANULARITY_ODT_ENTRY_SIZE_DAQ_BYTE 0xF0 NO_OVERLOAD_INDICATION /begin TIMESTAMP_SUPPORTED 0x0A SIZE_DWORD UNIT_1NS TIMESTAMP_FIXED /end TIMESTAMP_SUPPORTED /begin EVENT "DAQ_R5" "DAQ_R5" 0x00 DAQ 0xFF 0xFA 0x02 0x00 /end EVENT /begin EVENT "daq_1ms" "daq_1ms" 0x01 DAQ 0xFF 0x64 0x04 0x00 /end EVENT /begin EVENT "daq_10ms" "daq_10ms" 0x02 DAQ 0xFF 0x64 0x05 0x00 /end EVENT /begin EVENT "daq_100ms" "daq_100ms" 0x03 DAQ 0xFF 0x64 0x06 0x00 /end EVENT /begin EVENT "daq_1s" "daq_1s" 0x04 DAQ 0xFF 0x64 0x07 0x00 /end EVENT /end DAQ
 /begin PAG 0x00 /end PAG
 /begin PGM PGM_MODE_ABSOLUTE 0x00 0x00 /end PGM
 /begin XCP_ON_UDP_IP 0x0103 0x15B4 ADDRESS "192.168.1.233" /end XCP_ON_UDP_IP
/end IF_DATA
/begin TYPEDEF_STRUCTURE ADCcard "" 0x40 /begin STRUCTURE_COMPONENT cf ConversionFactors 0 /end STRUCTURE_COMPONENT /begin STRUCTURE_COMPONENT me Measurements 32 /end STRUCTURE_COMPONENT /end TYPEDEF_STRUCTURE
/begin TYPEDEF_STRUCTURE AnalogAdapters "" 0xC0 /begin STRUCTURE_COMPONENT A1 ADCcard 0 /end STRUCTURE_COMPONENT /begin STRUCTURE_COMPONENT A2 ADCcard 64 /end STRUCTURE_COMPONENT /begin STRUCTURE_COMPONENT A3 ADCcard 128 /end STRUCTURE_COMPONENT /end TYPEDEF_STRUCTURE
/begin TYPEDEF_STRUCTURE ConversionFactors "union ConversionFactors: only the first alternative is described, skipped: ADC_array" 0x20 /begin STRUCTURE_COMPONENT ADC_A1 M_FLOAT32_IEEE 0 /end STRUCTURE_COMPONENT /begin STRUCTURE_COMPONENT ADC_A2 M_FLOAT32_IEEE 4 /end STRUCTURE_COMPONENT /begin STRUCTURE_COMPONENT ADC_A3 M_FLOAT32_IEEE 8 /end STRUCTURE_COMPONENT /begin STRUCTURE_COMPONENT ADC_A4 M_FLOAT32_IEEE 12 /end STRUCTURE_COMPONENT /begin STRUCTURE_COMPONENT ADC_B5 M_FLOAT32_IEEE 16 /end STRUCTURE_COMPONENT /begin STRUCTURE_COMPONENT ADC_B6 M_FLOAT32_IEEE 20 /end STRUCTURE_COMPONENT /begin STRUCTURE_COMPONENT ADC_B7 M_FLOAT32_IEEE 24 /end STRUCTURE_COMPONENT /begin STRUCTURE_COMPONENT ADC_B8 M_FLOAT32_IEEE 28 /end STRUCTURE_COMPONENT /end TYPEDEF_STRUCTURE
/begin TYPEDEF_STRUCTURE DS_Data "objects (struct without measurable members) skipped" 0x1F8 /begin STRUCTURE_COMPONENT rasv referenceAndSetValues 0 /end STRUCTURE_COMPONENT /begin STRUCTURE_COMPONENT av actualValues 48 /end STRUCTURE_COMPONENT /begin STRUCTURE_COMPONENT aa AnalogAdapters 272 /end STRUCTURE_COMPONENT /end TYPEDEF_STRUCTURE
/begin TYPEDEF_MEASUREMENT M_FLOAT32_IEEE "" FLOAT32_IEEE NO_COMPU_METHOD 0 0 -3.4E+38 3.4E+38 /end TYPEDEF_MEASUREMENT
/begin TYPEDEF_MEASUREMENT M_ULONG "" ULONG NO_COMPU_METHOD 0 0 0 4294967295 /end TYPEDEF_MEASUREMENT
/begin TYPEDEF_STRUCTURE Measurements "union Measurements: only the first alternative is described, skipped: ADC_array" 0x20 /begin STRUCTURE_COMPONENT ADC_A1 M_FLOAT32_IEEE 0 /end STRUCTURE_COMPONENT /begin STRUCTURE_COMPONENT ADC_A2 M_FLOAT32_IEEE 4 /end STRUCTURE_COMPONENT /begin STRUCTURE_COMPONENT ADC_A3 M_FLOAT32_IEEE 8 /end STRUCTURE_COMPONENT /begin STRUCTURE_COMPONENT ADC_A4 M_FLOAT32_IEEE 12 /end STRUCTURE_COMPONENT /begin STRUCTURE_COMPONENT ADC_B5 M_FLOAT32_IEEE 16 /end STRUCTURE_COMPONENT /begin STRUCTURE_COMPONENT ADC_B6 M_FLOAT32_IEEE 20 /end STRUCTURE_COMPONENT /begin STRUCTURE_COMPONENT ADC_B7 M_FLOAT32_IEEE 24 /end STRUCTURE_COMPONENT /begin STRUCTURE_COMPONENT ADC_B8 M_FLOAT32_IEEE 28 /end STRUCTURE_COMPONENT /end TYPEDEF_STRUCTURE
/begin TYPEDEF_STRUCTURE actualValues "" 0xE0 /begin STRUCTURE_COMPONENT pwm_frequency_hz M_FLOAT32_IEEE 0 /end STRUCTURE_COMPONENT /begin STRUCTURE_COMPONENT isr_samplerate_s M_FLOAT32_IEEE 4 /end STRUCTURE_COMPONENT /begin STRUCTURE_COMPONENT I_L1 M_FLOAT32_IEEE 8 /end STRUCTURE_COMPONENT /begin STRUCTURE_COMPONENT I_L2 M_FLOAT32_IEEE 12 /end STRUCTURE_COMPONENT /begin STRUCTURE_COMPONENT I_L3 M_FLOAT32_IEEE 16 /end STRUCTURE_COMPONENT /begin STRUCTURE_COMPONENT U_L1 M_FLOAT32_IEEE 20 /end STRUCTURE_COMPONENT /begin STRUCTURE_COMPONENT U_L2 M_FLOAT32_IEEE 24 /end STRUCTURE_COMPONENT /begin STRUCTURE_COMPONENT U_L3 M_FLOAT32_IEEE 28 /end STRUCTURE_COMPONENT /begin STRUCTURE_COMPONENT I_U M_FLOAT32_IEEE 32 /end STRUCTURE_COMPONENT /begin STRUCTURE_COMPONENT I_V M_FLOAT32_IEEE 36 /end STRUCTURE_COMPONENT /begin STRUCTURE_COMPONENT I_W M_FLOAT32_IEEE 40 /end STRUCTURE_COMPONENT /begin STRUCTURE_COMPONENT U_U M_FLOAT32_IEEE 44 /end STRUCTURE_COMPONENT /begin STRUCTURE_COMPONENT U_V M_FLOAT32_IEEE 48 /end STRUCTURE_COMPONENT /begin STRUCTURE_COMPONENT U_W M_FLOAT32_IEEE 52 /end STRUCTURE_COMPONENT /begin STRUCTURE_COMPONENT U_ZK M_FLOAT32_IEEE 56 /end STRUCTURE_COMPONENT /begin STRUCTURE_COMPONENT U_ZK2 M_FLOAT32_IEEE 60 /end STRUCTURE_COMPONENT /begin STRUCTURE_COMPONENT Res1 M_FLOAT32_IEEE 64 /end STRUCTURE_COMPONENT /begin STRUCTURE_COMPONENT Res2 M_FLOAT32_IEEE 68 /end STRUCTURE_COMPONENT /begin STRUCTURE_COMPONENT mechanicalRotorSpeed M_FLOAT32_IEEE 72 /end STRUCTURE_COMPONENT /begin STRUCTURE_COMPONENT mechanicalRotorSpeed_filtered M_FLOAT32_IEEE 76 /end STRUCTURE_COMPONENT /begin STRUCTURE_COMPONENT mechanicalPosition M_FLOAT32_IEEE 80 /end STRUCTURE_COMPONENT /begin STRUCTURE_COMPONENT mechanicalTorque M_FLOAT32_IEEE 84 /end STRUCTURE_COMPONENT /begin STRUCTURE_COMPONENT mechanicalTorqueSensitive M_FLOAT32_IEEE 88 /end STRUCTURE_COMPONENT /begin STRUCTURE_COMPONENT mechanicalTorqueObserved M_FLOAT32_IEEE 92 /end STRUCTURE_COMPONENT /begin STRUCTURE_COMPONENT I_d M_FLOAT32_IEEE 96 /end STRUCTURE_COMPONENT /begin STRUCTURE_COMPONENT I_q M_FLOAT32_IEEE 100 /end STRUCTURE_COMPONENT /begin STRUCTURE_COMPONENT U_d M_FLOAT32_IEEE 104 /end STRUCTURE_COMPONENT /begin STRUCTURE_COMPONENT U_q M_FLOAT32_IEEE 108 /end STRUCTURE_COMPONENT /begin STRUCTURE_COMPONENT theta_elec M_FLOAT32_IEEE 112 /end STRUCTURE_COMPONENT /begin STRUCTURE_COMPONENT theta_mech M_FLOAT32_IEEE 116 /end STRUCTURE_COMPONENT /begin STRUCTURE_COMPONENT theta_offset M_FLOAT32_IEEE 120 /end STRUCTURE_COMPONENT /begin STRUCTURE_COMPONENT temperature M_FLOAT32_IEEE 124 /end STRUCTURE_COMPONENT /begin STRUCTURE_COMPONENT heartbeatframe_content M_ULONG 128 /end STRUCTURE_COMPONENT /begin STRUCTURE_COMPONENT electricalRotorSpeed M_FLOAT32_IEEE 132 /end STRUCTURE_COMPONENT /begin STRUCTURE_COMPONENT snd_fld M_FLOAT32_IEEE 136 MATRIX_DIM 21 /end STRUCTURE_COMPONENT /begin STRUCTURE_COMPONENT slowDataCounter M_ULONG 220 /end STRUCTURE_COMPONENT /end TYPEDEF_STRUCTURE
/begin TYPEDEF_STRUCTURE referenceAndSetValues "" 0x30 /begin STRUCTURE_COMPONENT halfBridge1DutyCycle M_FLOAT32_IEEE 0 /end STRUCTURE_COMPONENT /begin STRUCTURE_COMPONENT halfBridge2DutyCycle M_FLOAT32_IEEE 4 /end STRUCTURE_COMPONENT /begin STRUCTURE_COMPONENT halfBridge3DutyCycle M_FLOAT32_IEEE 8 /end STRUCTURE_COMPONENT /begin STRUCTURE_COMPONENT halfBridge4DutyCycle M_FLOAT32_IEEE 12 /end STRUCTURE_COMPONENT /begin STRUCTURE_COMPONENT halfBridge5DutyCycle M_FLOAT32_IEEE 16 /end STRUCTURE_COMPONENT /begin STRUCTURE_COMPONENT halfBridge6DutyCycle M_FLOAT32_IEEE 20 /end STRUCTURE_COMPONENT /begin STRUCTURE_COMPONENT halfBridge7DutyCycle M_FLOAT32_IEEE 24 /end STRUCTURE_COMPONENT /begin STRUCTURE_COMPONENT halfBridge8DutyCycle M_FLOAT32_IEEE 28 /end STRUCTURE_COMPONENT /begin STRUCTURE_COMPONENT halfBridge9DutyCycle M_FLOAT32_IEEE 32 /end STRUCTURE_COMPONENT /begin STRUCTURE_COMPONENT halfBridge10DutyCycle M_FLOAT32_IEEE 36 /end STRUCTURE_COMPONENT /begin STRUCTURE_COMPONENT halfBridge11DutyCycle M_FLOAT32_IEEE 40 /end STRUCTURE_COMPONENT /begin STRUCTURE_COMPONENT halfBridge12DutyCycle M_FLOAT32_IEEE 44 /end STRUCTURE_COMPONENT /end TYPEDEF_STRUCTURE
/begin INSTANCE Global_Data "complete structure; layout from the ELF DWARF via tools/xcp_test/dwarf_structs.py, address refreshes from the ELF through SYMBOL_LINK" DS_Data 0x40056E4C SYMBOL_LINK "Global_Data" 0 /end INSTANCE
/begin INSTANCE Global_Data.aa "complete structure; layout from the ELF DWARF via tools/xcp_test/dwarf_structs.py, address refreshes from the ELF through SYMBOL_LINK" AnalogAdapters 0x40056F5C SYMBOL_LINK "Global_Data.aa" 0 /end INSTANCE
/begin MEASUREMENT Global_Data.aa.A1.me.ADC_array "" FLOAT32_IEEE NO_COMPU_METHOD 0 0 -3.40282346639E+38 3.40282346639E+38 ECU_ADDRESS 0x40056F7C MATRIX_DIM 8 /end MEASUREMENT
/begin INSTANCE Global_Data.av "complete structure; layout from the ELF DWARF via tools/xcp_test/dwarf_structs.py, address refreshes from the ELF through SYMBOL_LINK" actualValues 0x40056E7C SYMBOL_LINK "Global_Data.av" 0 /end INSTANCE
/begin INSTANCE Global_Data.rasv "complete structure; layout from the ELF DWARF via tools/xcp_test/dwarf_structs.py, address refreshes from the ELF through SYMBOL_LINK" referenceAndSetValues 0x40056E4C SYMBOL_LINK "Global_Data.rasv" 0 /end INSTANCE
/begin CHARACTERISTIC Global_Data.rasv.halfBridge10DutyCycle "" VALUE 0x40056E70 __Float32_Value 0 NO_COMPU_METHOD -3.40282346639E+38 3.40282346639E+38 /end CHARACTERISTIC
/begin CHARACTERISTIC Global_Data.rasv.halfBridge11DutyCycle "" VALUE 0x40056E74 __Float32_Value 0 NO_COMPU_METHOD -3.40282346639E+38 3.40282346639E+38 /end CHARACTERISTIC
/begin CHARACTERISTIC Global_Data.rasv.halfBridge12DutyCycle "" VALUE 0x40056E78 __Float32_Value 0 NO_COMPU_METHOD -3.40282346639E+38 3.40282346639E+38 /end CHARACTERISTIC
/begin CHARACTERISTIC Global_Data.rasv.halfBridge1DutyCycle "" VALUE 0x40056E4C __Float32_Value 0 NO_COMPU_METHOD -3.40282346639E+38 3.40282346639E+38 /end CHARACTERISTIC
/begin CHARACTERISTIC Global_Data.rasv.halfBridge2DutyCycle "" VALUE 0x40056E50 __Float32_Value 0 NO_COMPU_METHOD -3.40282346639E+38 3.40282346639E+38 /end CHARACTERISTIC
/begin CHARACTERISTIC Global_Data.rasv.halfBridge3DutyCycle "" VALUE 0x40056E54 __Float32_Value 0 NO_COMPU_METHOD -3.40282346639E+38 3.40282346639E+38 /end CHARACTERISTIC
/begin CHARACTERISTIC Global_Data.rasv.halfBridge4DutyCycle "" VALUE 0x40056E58 __Float32_Value 0 NO_COMPU_METHOD -3.40282346639E+38 3.40282346639E+38 /end CHARACTERISTIC
/begin CHARACTERISTIC Global_Data.rasv.halfBridge5DutyCycle "" VALUE 0x40056E5C __Float32_Value 0 NO_COMPU_METHOD -3.40282346639E+38 3.40282346639E+38 /end CHARACTERISTIC
/begin CHARACTERISTIC Global_Data.rasv.halfBridge6DutyCycle "" VALUE 0x40056E60 __Float32_Value 0 NO_COMPU_METHOD -3.40282346639E+38 3.40282346639E+38 /end CHARACTERISTIC
/begin CHARACTERISTIC Global_Data.rasv.halfBridge7DutyCycle "" VALUE 0x40056E64 __Float32_Value 0 NO_COMPU_METHOD -3.40282346639E+38 3.40282346639E+38 /end CHARACTERISTIC
/begin CHARACTERISTIC Global_Data.rasv.halfBridge8DutyCycle "" VALUE 0x40056E68 __Float32_Value 0 NO_COMPU_METHOD -3.40282346639E+38 3.40282346639E+38 /end CHARACTERISTIC
/begin CHARACTERISTIC Global_Data.rasv.halfBridge9DutyCycle "" VALUE 0x40056E6C __Float32_Value 0 NO_COMPU_METHOD -3.40282346639E+38 3.40282346639E+38 /end CHARACTERISTIC
/begin MEASUREMENT ISR_execution_time_us "live from timingR5 (uz_SystemTime)" FLOAT32_IEEE NO_COMPU_METHOD 0 0 -3.40282346639E+38 3.40282346639E+38 ECU_ADDRESS 0x400585D4 SYMBOL_LINK "timingR5.isr_execution_time_us" 0 /end MEASUREMENT
/begin MEASUREMENT ISR_period_us "live from timingR5 (uz_SystemTime)" FLOAT32_IEEE NO_COMPU_METHOD 0 0 -3.40282346639E+38 3.40282346639E+38 ECU_ADDRESS 0x400585D0 SYMBOL_LINK "timingR5.isr_period_us" 0 /end MEASUREMENT
/begin MEASUREMENT System_UpTime_seconds "" FLOAT32_IEEE NO_COMPU_METHOD 0 0 -3.40282346639E+38 3.40282346639E+38 ECU_ADDRESS 0x400B7FF8 /end MEASUREMENT
/begin MEASUREMENT interrupt_counter "ISR tick counter, live from timingR5 (complete count, no wrap)" A_UINT64 NO_COMPU_METHOD 0 0 0 1.84467440737E+19 ECU_ADDRESS 0x400585D8 SYMBOL_LINK "timingR5.interrupt_counter" 0 /end MEASUREMENT
/begin MEASUREMENT lifecheck "control cycles since start modulo 1000, refreshed every control cycle right before the DAQ_R5 sampling; a jump in a DAQ_R5 recording = lost samples (javascope/check_lifecheck.py)" FLOAT32_IEEE NO_COMPU_METHOD 0 0 0 999 ECU_ADDRESS 0x400B7FF0 /end MEASUREMENT
/begin MEASUREMENT timingR5 "" UBYTE NO_COMPU_METHOD 0 0 0 255 ECU_ADDRESS 0x400585D0 /end MEASUREMENT
/begin MEASUREMENT ultrazohm_state.current_state "" UBYTE platform_state_t 0 0 0 255 ECU_ADDRESS 0x40056DC8 /end MEASUREMENT
/begin MEASUREMENT xcp_gw_ctoq_dropped "A53: CTO queue full, response dropped (must stay 0) [fixed OCM address 0xFFFFC01C, slot 5 of the XCP_IN header mirror]" ULONG NO_COMPU_METHOD 0 0 0 4294967295 ECU_ADDRESS 0xFFFFC01C /end MEASUREMENT
/begin MEASUREMENT xcp_gw_in_batches_sent "A53: command batches (generations) offered to the R5 [fixed OCM address 0xFFFFC020, slot 6 of the XCP_IN header mirror]" ULONG NO_COMPU_METHOD 0 0 0 4294967295 ECU_ADDRESS 0xFFFFC020 /end MEASUREMENT
/begin MEASUREMENT xcp_gw_in_retry_cycles "A53: IPIs spent re-offering an unacknowledged command batch (normal under load) [fixed OCM address 0xFFFFC024, slot 7 of the XCP_IN header mirror]" ULONG NO_COMPU_METHOD 0 0 0 4294967295 ECU_ADDRESS 0xFFFFC024 /end MEASUREMENT
/begin MEASUREMENT xcp_gw_ipi_count "A53: IPIs handled (liveness; ~ R5 sweep count) [fixed OCM address 0xFFFFC038, slot 12 of the XCP_IN header mirror]" ULONG NO_COMPU_METHOD 0 0 0 4294967295 ECU_ADDRESS 0xFFFFC038 /end MEASUREMENT
/begin MEASUREMENT xcp_gw_master_lost "A53: sessions closed by the gateway because the master became unreachable (send failures or silence timeout) [fixed OCM address 0xFFFFC040, slot 14 of the XCP_IN header mirror]" ULONG NO_COMPU_METHOD 0 0 0 4294967295 ECU_ADDRESS 0xFFFFC040 /end MEASUREMENT
/begin MEASUREMENT xcp_gw_ocm_capped "A53: per-IPI drain cap hit, rest of the cycle lost [fixed OCM address 0xFFFFC014, slot 3 of the XCP_IN header mirror]" ULONG NO_COMPU_METHOD 0 0 0 4294967295 ECU_ADDRESS 0xFFFFC014 /end MEASUREMENT
/begin MEASUREMENT xcp_gw_ocm_cycles_missed "A53: R5 sweeps between two header copies = IPI latency indicator, not a loss [fixed OCM address 0xFFFFC010, slot 2 of the XCP_IN header mirror]" ULONG NO_COMPU_METHOD 0 0 0 4294967295 ECU_ADDRESS 0xFFFFC010 /end MEASUREMENT
/begin MEASUREMENT xcp_gw_ocm_skipped_writing "A53: header copy unusable (R5 mid-sweep), mailbox and ack taken next IPI, DAQ chain read anyway (occasional ok) [fixed OCM address 0xFFFFC008, slot 0 of the XCP_IN header mirror]" ULONG NO_COMPU_METHOD 0 0 0 4294967295 ECU_ADDRESS 0xFFFFC008 /end MEASUREMENT
/begin MEASUREMENT xcp_gw_ocm_torn "A53: DAQ chain rewritten during the read (chain number changed), read discarded (rare) [fixed OCM address 0xFFFFC00C, slot 1 of the XCP_IN header mirror]" ULONG NO_COMPU_METHOD 0 0 0 4294967295 ECU_ADDRESS 0xFFFFC00C /end MEASUREMENT
/begin MEASUREMENT xcp_gw_rx_malformed_drop "A53: datagram with broken TL framing or frame > 248 B dropped on RX (must stay 0 with CANape) [fixed OCM address 0xFFFFC02C, slot 9 of the XCP_IN header mirror]" ULONG NO_COMPU_METHOD 0 0 0 4294967295 ECU_ADDRESS 0xFFFFC02C /end MEASUREMENT
/begin MEASUREMENT xcp_gw_sendto_drop "A53: batch dropped after bounded retries = the only ECU-side wire CTR gap source (must stay 0) [fixed OCM address 0xFFFFC034, slot 11 of the XCP_IN header mirror]" ULONG NO_COMPU_METHOD 0 0 0 4294967295 ECU_ADDRESS 0xFFFFC034 /end MEASUREMENT
/begin MEASUREMENT xcp_gw_sendto_err "A53: transient lwip_sendto failures, retried (pressure, not loss) [fixed OCM address 0xFFFFC030, slot 10 of the XCP_IN header mirror]" ULONG NO_COMPU_METHOD 0 0 0 4294967295 ECU_ADDRESS 0xFFFFC030 /end MEASUREMENT
/begin MEASUREMENT xcp_gw_tx_malformed_drop "A53: record failed the TL-frame walk on TX (must stay 0) [fixed OCM address 0xFFFFC028, slot 8 of the XCP_IN header mirror]" ULONG NO_COMPU_METHOD 0 0 0 4294967295 ECU_ADDRESS 0xFFFFC028 /end MEASUREMENT
/begin MEASUREMENT xcp_gw_txq_dropped "A53: DAQ queue full, record tail-dropped (UDP drain slower than DAQ; NOT visible as wire CTR gap) [fixed OCM address 0xFFFFC018, slot 4 of the XCP_IN header mirror]" ULONG NO_COMPU_METHOD 0 0 0 4294967295 ECU_ADDRESS 0xFFFFC018 /end MEASUREMENT
/begin MEASUREMENT xcp_gw_txq_level "A53: DAQ queue fill level (gauge: backlog waiting for UDP, 0 in steady state) [fixed OCM address 0xFFFFC03C, slot 13 of the XCP_IN header mirror]" ULONG NO_COMPU_METHOD 0 0 0 4294967295 ECU_ADDRESS 0xFFFFC03C /end MEASUREMENT
/begin MEASUREMENT xcp_r5_cto_dropped "R5: command response dropped, pending FIFO full (must stay 0 since the batch-resume fix; master sees a timeout)" ULONG NO_COMPU_METHOD 0 0 0 4294967295 ECU_ADDRESS 0x400B7E00 /end MEASUREMENT
/begin MEASUREMENT xcp_r5_queue_lost "DAQ samples dropped in R5 queue (must stay 0; NOT visible as wire CTR gap)" ULONG NO_COMPU_METHOD 0 0 0 4294967295 ECU_ADDRESS 0x400B7DFC /end MEASUREMENT
/begin MEASUREMENT xcp_r5_sweep_gap_max_us "max gap between main-loop XCP sweeps [us] (queue headroom indicator)" ULONG NO_COMPU_METHOD 0 0 0 4294967295 ECU_ADDRESS 0x400B7E30 /end MEASUREMENT
/begin MEASUREMENT xcp_r5_write_denied "R5: calibration writes refused by the write gate (target outside the data sections, or measurement-only build)" ULONG NO_COMPU_METHOD 0 0 0 4294967295 ECU_ADDRESS 0x400B7D90 /end MEASUREMENT
/begin COMPU_METHOD FOC_SCF_P.FOC_ENABLE_Idq_Ref.Conversion "" TAB_VERB "%6.3" "" COMPU_TAB_REF FOC_SCF_P.FOC_ENABLE_Idq_Ref.Conversion.StatusTable /end COMPU_METHOD
/begin COMPU_METHOD platform_state_t "" TAB_VERB "%.0" "" COMPU_TAB_REF platform_state_t /end COMPU_METHOD
/begin COMPU_VTAB FOC_SCF_P.FOC_ENABLE_Idq_Ref.Conversion.StatusTable "" TAB_VERB 2 0 "OFF" 1 "ON" /end COMPU_VTAB
/begin COMPU_VTAB platform_state_t "" TAB_VERB 4 0 "idle_state" 1 "running_state" 2 "control_state" 3 "error_state" /end COMPU_VTAB
/begin RECORD_LAYOUT __Float32_Value FNC_VALUES 1 FLOAT32_IEEE ROW_DIR DIRECT /end RECORD_LAYOUT
/end MODULE
/end PROJECT
